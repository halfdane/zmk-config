
// using a pro_micro like shield (like nice!nano)
// the pins 10 and 16 are the two bottom right pins
// see https://zmk.dev/docs/development/new-shield#shield-overlays

/ {
    chosen {
        zmk,kscan = &kscan0;
    };

    kscan0: kscan_0 {
        compatible = "zmk,kscan-gpio-matrix";
        diode-direction = "row2col";

        row-gpios
            = <&pro_micro 10 (GPIO_ACTIVE_HIGH | GPIO_PULL_DOWN)>
            ;

        col-gpios
            =  <&pro_micro 16 GPIO_ACTIVE_HIGH>
            ;

    };
};