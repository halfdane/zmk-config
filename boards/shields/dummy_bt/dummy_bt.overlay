
// using a pro_micro like shield (like nice!nano)
// the pins 10 and 16 are the two bottom right pins
// see https://zmk.dev/docs/development/new-shield#shield-overlays

/ {
    chosen {
        zmk,kscan = &kscan0;
    };

    kscan0: kscan_0 {
        compatible = "zmk,kscan-gpio-matrix";
        diode-direction = "row2col";

        row-gpios
            = <&pro_micro 15 (GPIO_ACTIVE_HIGH | GPIO_PULL_DOWN)>
            , <&pro_micro 14 (GPIO_ACTIVE_HIGH | GPIO_PULL_DOWN)>
            ;

        col-gpios
            = <&pro_micro 16 GPIO_ACTIVE_HIGH>
            , <&pro_micro 10 GPIO_ACTIVE_HIGH>
            ;
// This pin configuration (row: 15, 14 / col: 16 / 10)
// translates to connecting the following keyboard matrix
// Connecting these pins with tweezers to press the buttons Top / Bottom Left / Right:
// 15 + 16 = TL 
// 15 + 10 = TR
// 14 + 16 = BL
// 14 + 10 = BR

    };
};